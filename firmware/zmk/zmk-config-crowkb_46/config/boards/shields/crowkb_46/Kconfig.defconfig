## firmware/zmk/zmk-config-crowkb_46/config/boards/shields/crowkb_46/Kconfig.defconfig
```kconfig
if SHIELD_CROWKB_LEFT

config ZMK_KEYBOARD_NAME
    default "crowkb"

config ZMK_SPLIT_ROLE_CENTRAL
    default y

endif

if SHIELD_CROWKB_LEFT || SHIELD_CROWKB_RIGHT

config ZMK_SPLIT
    default y

endif
```

## firmware/zmk/zmk-config-crowkb_46/config/boards/shields/crowkb_46/Kconfig.shield
```kconfig
config SHIELD_CROWKB_LEFT
    def_bool $(shields_list_contains,crowkb_left)

config SHIELD_CROWKB_RIGHT
    def_bool $(shields_list_contains,crowkb_right)
```
